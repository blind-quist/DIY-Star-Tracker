/*
Star Tracker by Brandon Lindquist 
2022

Arduino:	Arduino Uno
Motor:		28BYJ-48 Stepper Motor with ULN2003 Driver
LCD Display:	DFROBOT Gravity: 1602 LCD Keypad Shield
*/

#include <AccelStepper.h>
#include <LiquidCrystal.h>

//////////////////// *** LCD PANEL *** ////////////////////
// Arduino 2x16 LCD
// D04 - D010 are taken by LCD Shield
LiquidCrystal lcd(8, 9, 4, 5, 6, 7);

// Define values used by the panel and buttons
int adc_key_in = 0;   // Value generated by the button
int key = 0;          // Inital value of converted key

// {FUNCTION} Convert button presses to values
#define btnNONE 0     // Keys
#define btnRIGHT 1    
#define btnUP 2
#define btnDOWN 3
#define btnLEFT 4
#define btnSELECT 5
int read_LCD_buttons() {       // read the buttons
  adc_key_in = analogRead(0);  // read the value from the sensor
  // Values output by buttons, see DFROBOT LCD KeyPad Shield For Arduino SKU: DFR0009
  if (adc_key_in > 1000) return btnNONE;
  // For DFROBOT LCD KeyPad Shield
  if (adc_key_in < 50)  return btnRIGHT;
  if (adc_key_in < 250) return btnUP;
  if (adc_key_in < 450) return btnDOWN;
  if (adc_key_in < 650) return btnLEFT;
  if (adc_key_in < 850) return btnSELECT;
  return btnNONE; // when all others fail, return this.
}

//////////////////// *** MOTOR *** ////////////////////
// Requires "AccelStepper" Library
#define HALFSTEP 8 // Moter Interface Type: HALFSTEP, 4096 steps per revolution (4076 steps actually?)
/* Motor pin definitions when using DFROBOT LCD KeyPad Shield
D04 - D010 are taken by LCD Shield */
#define motorPin1  1     // IN1 on the ULN2003 driver 1 to D01 on LCD shield 
#define motorPin2  2     // IN2 on the ULN2003 driver 1 to D02 on LCD shield
#define motorPin3  3     // IN3 on the ULN2003 driver 1 to D03 on LCD shield
#define motorPin4  11    // IN4 on the ULN2003 driver 1 to D11 on LCD shield

AccelStepper stepper1 = AccelStepper(HALFSTEP, motorPin1, motorPin3, motorPin2, motorPin4);
// Define motor values
int isRun;                        // Motor running logic
double speeds = 199.72;           // {DEFINE DEFAULT SPEED} Steps per second
int maxspeed = 1000;              // {DEFINE MAX SPEED}

// {FUNCTION} Display Speed
void DisplaySpeed() {
  lcd.setCursor(0, 1);
  lcd.print("Speed "); 
  lcd.print(speeds);
  lcd.print("    ");
}

//////////////////// *** MAIN SETUP *** ////////////////////
void setup() {                    
  // LCD SETUP //
  lcd.clear();                    // clear the lcd
  lcd.begin(16, 2);               // set up the LCD's number of columns and rows:
  // Top Row
  lcd.setCursor(0,0);             // set cursor to row 0, col 0
  lcd.print("Motor Stopped   ");  // display "Motor Stopped" on the LCD
  // Bottom Row
  lcd.setCursor(0,1);             // set cursor to row 0, col 1
  lcd.print("Speed ");            // display the value of speeds
  lcd.print(speeds);              
  lcd.print("   ");
  
  // MOTOR SETUP //
  isRun = 0;                      // Set motor running logic
  stepper1.setMaxSpeed(maxspeed); // {MAX SPEED}
  stepper1.setSpeed(speeds);      // {DEFAULT SPEED}
}

//////////////////// *** MAIN LOOP *** ////////////////////
void loop() {
  key = read_LCD_buttons();       // Read Buttons, convert to values with function

  if (key >= 0) {  
      if (key == btnSELECT) {             // SELECT to start and stop
        isRun = 1 - isRun;                      // (running logic)
          lcd.setCursor(0,0); 
          if (isRun == 1) {
            lcd.print("+++ Running +++ ");
          } 
          else {
            lcd.print("Motor Stopped  "); 
          }
          delay(50); // delay 50ms
      }
      if (key == btnUP) {                 // UP to increase speed by 0.1
         speeds = speeds + 0.1;
         DisplaySpeed();
         delay(50);
      }
      if (key == btnDOWN) {               // DOWN to decrease speed by 0.1
         speeds = speeds - 0.1;
         DisplaySpeed();
         delay(50);
      }
      if (key == btnRIGHT) {              // RIGHT to increase speed by 10                   
         speeds += 10;
         DisplaySpeed();
         delay(50);
      }
      if (key == btnLEFT) {               // LEFT to decrease speed by 10
         speeds -= 10;
         DisplaySpeed();
         delay(50);
      }
      if (speeds > maxspeed) {            // (Prevent speed from going over maxspeed)
         speeds = maxspeed;
      }
      if (speeds < -maxspeed) {
         speeds = -maxspeed;
      }                       
      stepper1.setSpeed(speeds);          // Set speed
  }

  // MOTOR RUNS //
  if (isRun == 1) {
    stepper1.runSpeed();
  }
}